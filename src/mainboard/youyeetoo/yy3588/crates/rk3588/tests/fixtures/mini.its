## src/mainboard/youyeetoo/yy3588/crates/rk3588/tests/fixtures/mini.its
```
/*
 * Test fixture shaped like edk2-rk3588 misc/uefi_rk3588.its (no OP-TEE):
 * build with `mkimage -f mini.its -E mini.itb` from small payload files
 * (edk2.bin 3000 bytes of (i*7)&0xff, atf1.bin 1500 of (i*3+1)&0xff,
 * atf2.bin 700 of (i*5+2)&0xff, dtb.bin 64 zero bytes).
 */
/dts-v1/;
/ {
	description = "mini edk2-rk3588 shaped FIT";
	#address-cells = <1>;
	images {
		edk2 {
			data = /incbin/("./edk2.bin");
			type = "standalone";
			arch = "arm64";
			os = "EDK2";
			compression = "none";
			load = <0x00200000>;
			hash { algo = "sha256"; };
		};
		atf-1 {
			data = /incbin/("./atf1.bin");
			type = "firmware";
			arch = "arm64";
			os = "arm-trusted-firmware";
			compression = "none";
			load = <0x00040000>;
			hash { algo = "sha256"; };
		};
		atf-2 {
			data = /incbin/("./atf2.bin");
			type = "firmware";
			arch = "arm64";
			os = "arm-trusted-firmware";
			compression = "none";
			load = <0xff100000>;
			hash { algo = "sha256"; };
		};
		fdt {
			data = /incbin/("./dtb.bin");
			type = "flat_dt";
			arch = "arm64";
			compression = "none";
			hash { algo = "sha256"; };
		};
		nvdata {
			data-position = <0x00002000>;
			data-size = <0x00000400>;
			type = "standalone";
			arch = "arm64";
			compression = "none";
			load = <0x007C0000>;
		};
	};
	configurations {
		default = "conf";
		conf {
			firmware = "atf-1";
			loadables = "edk2", "atf-2", "nvdata";
			fdt = "fdt";
		};
	};
};
```
